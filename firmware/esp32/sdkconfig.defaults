## firmware/esp32/sdkconfig.defaults
```kconfig
CONFIG_FREERTOS_HZ=1000
CONFIG_ESP_CONSOLE_NONE=y
CONFIG_ESP_CONSOLE_SECONDARY_NONE=y
CONFIG_BOOTLOADER_LOG_LEVEL_NONE=y
CONFIG_LOG_DEFAULT_LEVEL_WARN=y
CONFIG_LOG_MAXIMUM_LEVEL_INFO=y
CONFIG_LOG_COLORS=n
CONFIG_ESPTOOLPY_FLASHSIZE_4MB=y
CONFIG_PARTITION_TABLE_SINGLE_APP_LARGE=y
CONFIG_COMPILER_OPTIMIZATION_PERF=y
CONFIG_ESP_MAIN_TASK_STACK_SIZE=6144
CONFIG_ESP_SYSTEM_EVENT_TASK_STACK_SIZE=4096
CONFIG_ESP_TIMER_TASK_STACK_SIZE=4096
```

## firmware/esp32/sdkconfig.defaults.esp32
```kconfig
CONFIG_BT_ENABLED=y
CONFIG_BTDM_CTRL_MODE_BLE_ONLY=y
CONFIG_BT_NIMBLE_ENABLED=y
CONFIG_BT_NIMBLE_HID_SERVICE=y
CONFIG_BT_NIMBLE_NVS_PERSIST=y
CONFIG_BT_NIMBLE_MAX_CONNECTIONS=1
CONFIG_BT_NIMBLE_ROLE_CENTRAL=y
CONFIG_BT_NIMBLE_GATT_CLIENT=y
CONFIG_BT_NIMBLE_ROLE_OBSERVER=n
CONFIG_BT_NIMBLE_ATT_PREFERRED_MTU=247
CONFIG_BT_NIMBLE_GAP_DEVICE_NAME_MAX_LEN=32
CONFIG_BT_NIMBLE_SVC_GAP_DEVICE_NAME="GameScrcpy Touch"
CONFIG_BT_NIMBLE_SVC_GAP_APPEARANCE=0x3C0
CONFIG_ESP_COEX_SW_COEXIST_ENABLE=y
```

## firmware/esp32/sdkconfig.defaults.esp32p4
```kconfig
CONFIG_TINYUSB_HID_COUNT=4
CONFIG_TINYUSB_CDC_COUNT=0
CONFIG_TINYUSB_MSC_ENABLED=n
CONFIG_TINYUSB_RHPORT_HS=y
```

## firmware/esp32/sdkconfig.defaults.esp32s2
```kconfig
CONFIG_TINYUSB_HID_COUNT=4
CONFIG_TINYUSB_CDC_COUNT=0
CONFIG_TINYUSB_MSC_ENABLED=n
CONFIG_ESP_WIFI_STATIC_RX_BUFFER_NUM=8
```
